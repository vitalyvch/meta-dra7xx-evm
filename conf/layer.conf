## conf/layer.conf
```bitbake
# We have a conf and classes directory, add to BBPATH
BBPATH .= ":${LAYERDIR}"

# We have a recipes-* directories, add to BBFILES
BBFILES += "${LAYERDIR}/recipes-*/*/*.bb \
	${LAYERDIR}/recipes-*/*/*.bbappend"

BBFILE_COLLECTIONS += "dra7xx-evm"
BBFILE_PATTERN_dra7xx-evm = "^${LAYERDIR}/"
BBFILE_PRIORITY_dra7xx-evm = "5"
```
